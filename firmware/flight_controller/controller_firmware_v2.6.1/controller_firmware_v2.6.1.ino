/*
  YMFC Flight Controller - Arduino Uno Safety Baseline V6.6C_QMC5883P_COMPASS
  =================================================================

  Purpose:
  - Fills the missing gaps from the provided skeleton:
      * Receiver pin-change interrupt reader
      * Latest PCB receiver mapping
      * ESC pulse output at 250 Hz
      * CH6 emergency lockout
      * CH5 Bench/Test/Normal caps
      * Basic MPU6050 roll/pitch self-level stabilization
      * Basic yaw-rate damping
      * Compass readout and optional heading hold
      * BMP280/BME280 barometer telemetry
      * PID logic
      * Motor mixing for latest motor layout
      * EEPROM calibration loading from ARC Setup Module v6.5 with safe defaults
      * Receiver failsafe
      * A0 battery percentage monitoring, telemetry, and emergency battery failsafe
      * LED status patterns
      * 5-second telemetry

  IMPORTANT SAFETY NOTES:
  - Test with props removed first.
  - This is a baseline stabilizer, not a final flight tune.
  - Barometer sensing is active for telemetry only. Barometer altitude hold is intentionally not included here.
  - If the UAV corrects in the wrong direction, stop immediately and flip the relevant sign
    constants in the CONFIGURABLE AXIS/MIXER SIGNS section.
  - If the compass fails, the controller does NOT cut motors and does NOT disarm.
    It disables heading hold, continues normal yaw-rate behavior, and reports a warning to WMS.
  - V6.6C reads QMC5883P data from registers 0x01..0x06; register 0x00 is chip ID 0x80.
  - This version reads the exact EEPROM layout written by the setup sketch you uploaded.

  Latest receiver PCB map:
    CH1 Roll     = D7
    CH2 Pitch    = D8
    CH3 Throttle = D5
    CH4 Yaw      = D4
    CH5 Mode     = D3
    CH6 Lockout  = D12

  ESC outputs:
    M1 = D6
    M2 = D9
    M3 = D10
    M4 = D11

  Latest physical motor layout used in this file:
    M1 = Front Right
    M4 = Front Left
    M2 = Rear Right
    M3 = Rear Left

  Serial:
    57600 baud
*/

#include <Wire.h>
#include <EEPROM.h>
#include <math.h>
#include <stdlib.h>
#include <string.h>

// ================================================================
// CONFIGURATION
// ================================================================

#define STATUS_LED_PIN 13

#define FIRMWARE_VERSION "FC-0.8.7"
#define FIRMWARE_REVISION "2026-06-23.3"

#define ESC1_PIN 6
#define ESC2_PIN 9
#define ESC3_PIN 10
#define ESC4_PIN 11

#define RX_CH1_PIN 7   // Roll
#define RX_CH2_PIN 8   // Pitch
#define RX_CH3_PIN 5   // Throttle
#define RX_CH4_PIN 4   // Yaw
#define RX_CH5_PIN 3   // Flight mode
#define RX_CH6_PIN 12  // Emergency lockout

#define BATTERY_SENSE_PIN A0
#define BATTERY_MONITOR_ENABLED true

#define LOOP_TIME_US 4000UL   // 250 Hz ESC/control loop
#define SERIAL_BAUD 115200  // Match the monitoring portal shown in your screenshot.

#define MPU6050_ADDR 0x68
#define COMPASS_ADDR 0x2C      // Project fixed compass address from setup sketch.
#define BMP280_ADDR 0x76
#define I2C_SPEED 400000L

#define ESC_MIN_US 1000
#define ESC_IDLE_US 1100     // 10% idle after arming
#define ESC_MAX_US 2000

#define ESC_CAP_BENCH 1400   // CH5 low
#define ESC_CAP_TEST  1700   // CH5 middle
#define ESC_CAP_NORMAL 2000  // CH5 high

#define RX_MIN_VALID 900
#define RX_MAX_VALID 2100
#define RX_TIMEOUT_US 150000UL

#define ARM_HOLD_MS 150
#define DISARM_HOLD_MS 150

#define STICK_LOW_US 1050
#define STICK_HIGH_US 1900
#define STICK_CENTER_LOW_US 1400
#define STICK_CENTER_HIGH_US 1600

#define STICK_DEADBAND_US 50

#define MAX_ANGLE_DEG 12.0f        // Max roll/pitch command angle
#define MAX_YAW_RATE_DPS 180.0f     // Max manual yaw-rate command
#define HEADING_HOLD_MAX_RATE_DPS 45.0f  // Max yaw-rate command generated by heading hold
#define HEADING_HOLD_P_GAIN 1.00f        // deg heading error -> deg/s yaw command
#define HEADING_HOLD_DEADBAND_DEG 3.0f   // Ignore tiny heading errors
#define HEADING_LOCK_DELAY_MS 100UL     // Yaw stick centered time before heading locks
#define COMPASS_UPDATE_INTERVAL_MS 50UL  // 20 Hz compass update, lower I2C load than 250 Hz
#define COMPASS_RETRY_INTERVAL_MS 500UL // Retry compass init every 1s if it fails
#define BARO_UPDATE_INTERVAL_MS 100UL    // 10 Hz barometer telemetry refresh.
#define BARO_RETRY_INTERVAL_MS 1000UL    // Retry barometer init if it is missing at boot.
#define BARO_SEA_LEVEL_HPA 1013.25f      // Used only for absolute estimated altitude display.
#define MAX_PID_OUTPUT 250.0f
#define MAX_YAW_OUTPUT 50.0f
#define PID_P_GAIN_MAX 50.0f
#define PID_I_GAIN_MAX 50.0f
#define PID_D_GAIN_MAX 50.0f

#define GYRO_SCALE_500DPS 65.5f    // MPU6050 gyro scale for +/-500 dps
#define ACC_SCALE_8G 4096.0f       // MPU6050 accel scale for +/-8 g

#define COMPLEMENTARY_GYRO_WEIGHT 0.98f
#define COMPLEMENTARY_ACC_WEIGHT  0.02f

#define TELEMETRY_INTERVAL_MS 500UL  // JSON telemetry interval for monitoring portal.
#define PID_TUNE_STEP 0.001f          // WMS PID tuning increment/decrement step.

#define BATTERY_SAMPLE_INTERVAL_MS 100UL
#define BATTERY_ADC_REFERENCE_V 5.0f
#define BATTERY_ADC_MAX_COUNTS 1023.0f
#define BATTERY_PERCENT_EMPTY_V 3.70f // A0 monitor voltage that represents 0%.
#define BATTERY_PERCENT_FULL_V 5.00f  // A0 monitor voltage that represents 100%.
#define BATTERY_FILTER_ALPHA 0.15f
#define BATTERY_MIN_VALID_V 0.05f
#define BATTERY_MAX_VALID_V 5.05f
#define BATTERY_DEFAULT_LOW_PERCENT 20.0f
#define BATTERY_DEFAULT_CRITICAL_PERCENT 9.0f
#define BATTERY_DEFAULT_EMERGENCY_PERCENT 0.0f

// ================================================================
// CONFIGURABLE AXIS/MIXER SIGNS
// ================================================================
//
// These are the first things to change if correction direction is wrong.
// Keep props removed while checking.
//
// Angle convention intended:
//   roll  positive = right side down / roll right
//   pitch positive = nose up
//   yaw   positive = yaw right
//
// Current board orientation has MPU roll/pitch axes physically crossed:
//   sensor pitch channel is aircraft roll
//   sensor roll channel is aircraft pitch
// Set this to 0 only if a future board mount restores normal MPU X/Y mapping.
//
// If corrected roll angle moves opposite in telemetry, flip ROLL_ANGLE_SIGN.
// If corrected pitch angle moves opposite in telemetry, flip PITCH_ANGLE_SIGN.
// If yaw rate moves opposite in telemetry, flip YAW_RATE_SIGN.
//
// If the angle displayed is correct but motor correction is backwards,
// flip MIX_ROLL_SIGN or MIX_PITCH_SIGN instead.

#define SWAP_ROLL_PITCH_AXES 1
#define ROLL_ANGLE_SIGN   1.0f
#define PITCH_ANGLE_SIGN  1.0f
#define YAW_RATE_SIGN     1.0f

#define MIX_ROLL_SIGN     1.0f
#define MIX_PITCH_SIGN    1.0f
#define MIX_YAW_SIGN      1.0f

// Flip this if heading hold turns the UAV away from the target instead of back to it.
#define HEADING_HOLD_SIGN 1.0f //Change from negative to positive

// ================================================================
// EEPROM CALIBRATION STRUCT
// ================================================================
//
// This matches your actual setup sketch:
//   "ARC Flight Controller - Setup Module v6.5 CPP FIXED"
// It uses signature "ARC", version 65, EEPROM.put(), and the same checksum logic.

#define EEPROM_CAL_ADDR 0
#define EEPROM_VERSION 65

#define SENSOR_MPU_OK      0x01
#define SENSOR_COMPASS_OK  0x02
#define SENSOR_BARO_OK     0x04

#define CH_ROLL       0
#define CH_PITCH      1
#define CH_THROTTLE   2
#define CH_YAW        3
#define CH_MODE       4
#define CH_LOCKOUT    5

struct ArcSetupData {
  char signature[3];       // 'A', 'R', 'C'
  uint8_t version;         // EEPROM_VERSION

  uint16_t rxCenter[6];
  uint16_t rxMin[6];
  uint16_t rxMax[6];

  // +1 means requested positive movement increases PWM from center.
  // -1 means requested positive movement decreases PWM from center.
  // Positive movements:
  //   roll right, pitch/nose up, yaw right, throttle high.
  int8_t rollDir;
  int8_t pitchDir;
  int8_t yawDir;
  int8_t throttleDir;

  // Semantic switch positions captured by setup.
  uint16_t ch5Up;
  uint16_t ch5Mid;
  uint16_t ch5Down;
  uint16_t ch6On;
  uint16_t ch6Off;

  // MPU6050 gyro zero offsets, raw ADC counts.
  int16_t gyroOffset[3];   // X, Y, Z

  // Stationary compass baseline/offset, raw counts.
  int16_t magBaseline[3];
  uint16_t magAvgDiffX100[3];
  uint16_t magMaxStepDiff[3];

  // BMP280 raw pressure baseline/offset.
  int32_t baroBaselineRaw;
  uint16_t baroAvgDiffX100;
  uint16_t baroMaxStepDiff;

  uint8_t sensorFlags;

  uint16_t checksum;       // Must remain last.
};

ArcSetupData cal;
bool calibrationFromEEPROM = false;

// ================================================================
// RECEIVER DATA
// ================================================================

struct ReceiverData {
  volatile uint16_t current_pulse[6];
  volatile uint32_t rise_time[6];
  volatile uint32_t last_update[6];
};

ReceiverData rx;

volatile uint8_t lastPINDState = 0;
volatile uint8_t lastPINBState = 0;

// ================================================================
// FLIGHT STATE
// ================================================================

enum FlightMode {
  FLIGHT_DISARMED = 0,
  FLIGHT_ARMED = 2
};

enum LedState {
  LED_NOT_READY = 0,
  LED_READY = 1,
  LED_ARMED = 2,
  LED_LOCKOUT = 3,
  LED_ERROR = 4
};

FlightMode flight_mode = FLIGHT_DISARMED;

bool receiver_ok = false;
bool sensor_ok = false;
bool gyro_calibrated = false;
bool emergencyLockoutActive = false;
bool rearmNeutralRequired = false;
bool loopOverrun = false;
bool batteryFailsafeActive = false;

uint32_t loop_timer = 0;
uint32_t ledTimer = 0;
uint32_t telemetryTimer = 0;
uint32_t batteryTimer = 0;
uint32_t baroTimer = 0;
uint32_t lastBaroRetryMs = 0;
uint32_t armStartMs = 0;
uint32_t disarmStartMs = 0;

int esc_1 = ESC_MIN_US;
int esc_2 = ESC_MIN_US;
int esc_3 = ESC_MIN_US;
int esc_4 = ESC_MIN_US;

int esc_cap = ESC_CAP_BENCH;

// Calibrated receiver values, 1000-2000 us.
uint16_t ch[6] = {1500, 1500, 1000, 1500, 1000, 1000};

// ================================================================
// BATTERY MONITOR STATE
// ================================================================

enum BatteryAlarmLevel {
  BATTERY_ALARM_OK = 0,
  BATTERY_ALARM_LOW = 1,
  BATTERY_ALARM_CRITICAL = 2,
  BATTERY_ALARM_EMERGENCY = 3
};

struct BatteryState {
  float monitorVoltage;
  uint8_t socPercent;
  BatteryAlarmLevel alarm;
  bool valid;
};

BatteryState battery = {
  0.0f,
  0,
  BATTERY_ALARM_OK,
  false
};

float batteryLowThreshold = BATTERY_DEFAULT_LOW_PERCENT;
float batteryCriticalThreshold = BATTERY_DEFAULT_CRITICAL_PERCENT;
float batteryEmergencyThreshold = BATTERY_DEFAULT_EMERGENCY_PERCENT;
bool batteryFilterReady = false;

// ================================================================
// BAROMETER STATE
// ================================================================

enum BaroStatus {
  BARO_NOT_STARTED = 0,
  BARO_OK = 1,
  BARO_NOT_FOUND = 2,
  BARO_BAD_ID = 3,
  BARO_INIT_FAIL = 4,
  BARO_READ_FAIL = 5
};

struct BarometerState {
  bool initialized;
  bool ok;
  uint8_t chipId;
  BaroStatus status;
  int32_t rawPressure;
  int32_t rawTemperature;
  float pressurePa;
  float temperatureC;
  float altitudeM;
  float relativeAltitudeM;
  float baselinePressurePa;
};

BarometerState baro = {
  false,
  false,
  0,
  BARO_NOT_STARTED,
  0,
  0,
  0.0f,
  0.0f,
  0.0f,
  0.0f,
  0.0f
};

uint16_t bmpDigT1 = 0;
int16_t bmpDigT2 = 0;
int16_t bmpDigT3 = 0;
uint16_t bmpDigP1 = 0;
int16_t bmpDigP2 = 0;
int16_t bmpDigP3 = 0;
int16_t bmpDigP4 = 0;
int16_t bmpDigP5 = 0;
int16_t bmpDigP6 = 0;
int16_t bmpDigP7 = 0;
int16_t bmpDigP8 = 0;
int16_t bmpDigP9 = 0;
int32_t bmpTFine = 0;

// ================================================================
// IMU / PID STATE
// ================================================================

int16_t acc_x_raw, acc_y_raw, acc_z_raw;
int16_t gyro_x_raw, gyro_y_raw, gyro_z_raw;

float gyro_roll_rate = 0.0f;
float gyro_pitch_rate = 0.0f;
float gyro_yaw_rate = 0.0f;

float angle_roll = 0.0f;
float angle_pitch = 0.0f;

bool firstAngle = true;
uint32_t lastImuMicros = 0;

// PID gains.
// Outputs are mixed directly as motor microseconds. These defaults make
// roll/pitch stick inputs visible on the bench while staying conservative.
float pid_p_gain_roll = 4.00f;
float pid_i_gain_roll = 0.02f;
float pid_d_gain_roll = 0.05f;

float pid_p_gain_pitch = 4.00f;
float pid_i_gain_pitch = 0.02f;
float pid_d_gain_pitch = 0.05f;

float pid_p_gain_yaw = 0.50f;
float pid_i_gain_yaw = 0.00f;
float pid_d_gain_yaw = 0.00f;

float pid_i_mem_roll = 0.0f;
float pid_i_mem_pitch = 0.0f;
float pid_i_mem_yaw = 0.0f;

float pid_output_roll = 0.0f;
float pid_output_pitch = 0.0f;
float pid_output_yaw = 0.0f;

// Command/setpoint values printed in telemetry.
float roll_cmd = 0.0f;
float pitch_cmd = 0.0f;
float yaw_cmd = 0.0f;

float last_yaw_error = 0.0f;
uint32_t lastPidMicros = 0;

// ================================================================
// COMPASS / HEADING HOLD STATE
// ================================================================

enum CompassStatus {
  COMPASS_NOT_STARTED = 0,
  COMPASS_OK = 1,
  COMPASS_NOT_FOUND = 2,
  COMPASS_INIT_FAIL = 3,
  COMPASS_READ_FAIL = 4,
  COMPASS_BAD_DATA = 5,
  COMPASS_ONE_AXIS_ONLY = 6,
  COMPASS_FLATLINED = 7
};

#define COMPASS_DRIVER_NONE 0
#define COMPASS_DRIVER_HMC  1
#define COMPASS_DRIVER_QMC  2
#define COMPASS_DRIVER_QMCP 3

byte compass_driver = COMPASS_DRIVER_NONE;
uint8_t compass_chip_id = 0;

bool compass_initialized = false;
bool compass_ok = false;
CompassStatus compass_status = COMPASS_NOT_STARTED;

int16_t mag_x_raw = 0;
int16_t mag_y_raw = 0;
int16_t mag_z_raw = 0;

int16_t last_mag_x_raw = 0;
int16_t last_mag_y_raw = 0;
int16_t last_mag_z_raw = 0;
uint16_t compassFlatlineCount = 0;
uint8_t compassBadReason = 0;

float compass_heading = 0.0f;   // 0 to 360 degrees.
float heading_target = 0.0f;    // Locked heading target.
float heading_error = 0.0f;     // Shortest signed target-current error.
bool heading_lock_active = false;

uint32_t lastCompassUpdateMs = 0;
uint32_t lastCompassRetryMs = 0;
uint32_t yawCenteredSinceMs = 0;


// ================================================================
// UTILITY FUNCTIONS
// ================================================================

float constrainFloat(float value, float low, float high) {
  if (value < low) return low;
  if (value > high) return high;
  return value;
}

float wrap360(float angle) {
  while (angle >= 360.0f) angle -= 360.0f;
  while (angle < 0.0f) angle += 360.0f;
  return angle;
}

float shortestAngleError(float targetDeg, float currentDeg) {
  float error = targetDeg - currentDeg;
  while (error > 180.0f) error -= 360.0f;
  while (error < -180.0f) error += 360.0f;
  return error;
}

uint16_t constrainPulse(int value) {
  if (value < ESC_MIN_US) return ESC_MIN_US;
  if (value > ESC_MAX_US) return ESC_MAX_US;
  return (uint16_t)value;
}

bool pulseInValidRange(uint16_t pulse) {
  return pulse >= RX_MIN_VALID && pulse <= RX_MAX_VALID;
}

uint16_t checksumCalibration(const ArcSetupData &data) {
  const uint8_t *p = (const uint8_t *)&data;
  size_t len = sizeof(ArcSetupData) - sizeof(data.checksum);
  uint16_t sum = 0xA5A5;

  for (size_t i = 0; i < len; i++) {
    sum = (uint16_t)((sum << 5) | (sum >> 11));
    sum ^= p[i];
  }

  return sum;
}

bool configSignatureOk(const ArcSetupData &data) {
  return data.signature[0] == 'A' &&
         data.signature[1] == 'R' &&
         data.signature[2] == 'C';
}

void setDefaultCalibration() {
  cal.signature[0] = 'A';
  cal.signature[1] = 'R';
  cal.signature[2] = 'C';
  cal.version = EEPROM_VERSION;

  for (byte i = 0; i < 6; i++) {
    cal.rxMin[i] = 1000;
    cal.rxCenter[i] = 1500;
    cal.rxMax[i] = 2000;
  }

  // Throttle safe/low is not a centered channel.
  cal.rxCenter[CH_THROTTLE] = 1000;

  cal.rollDir = +1;
  cal.pitchDir = +1;
  cal.yawDir = +1;
  cal.throttleDir = +1;

  cal.ch5Up = 2000;
  cal.ch5Mid = 1500;
  cal.ch5Down = 1000;
  cal.ch6On = 2000;
  cal.ch6Off = 1000;

  cal.gyroOffset[0] = 0;
  cal.gyroOffset[1] = 0;
  cal.gyroOffset[2] = 0;

  cal.magBaseline[0] = 0;
  cal.magBaseline[1] = 0;
  cal.magBaseline[2] = 0;

  cal.magAvgDiffX100[0] = 0;
  cal.magAvgDiffX100[1] = 0;
  cal.magAvgDiffX100[2] = 0;

  cal.magMaxStepDiff[0] = 0;
  cal.magMaxStepDiff[1] = 0;
  cal.magMaxStepDiff[2] = 0;

  cal.baroBaselineRaw = 0;
  cal.baroAvgDiffX100 = 0;
  cal.baroMaxStepDiff = 0;

  cal.sensorFlags = SENSOR_MPU_OK;
  cal.checksum = checksumCalibration(cal);

  calibrationFromEEPROM = false;
}

bool validDirection(int8_t d) {
  return d == 1 || d == -1;
}

bool validateCalibration(const ArcSetupData &data) {
  if (!configSignatureOk(data)) return false;
  if (data.version != EEPROM_VERSION) return false;
  if (data.checksum != checksumCalibration(data)) return false;

  for (byte i = 0; i < 6; i++) {
    if (data.rxMin[i] < 800 || data.rxMin[i] > 1300) return false;
    if (data.rxMax[i] < 1700 || data.rxMax[i] > 2200) return false;
    if (!(data.rxMin[i] < data.rxMax[i])) return false;

    // CH3 throttle center is intentionally throttle-low/safe in the setup sketch,
    // so do not require rxMin < rxCenter < rxMax for CH3.
    if (i == CH_THROTTLE) {
      if (data.rxCenter[i] < 800 || data.rxCenter[i] > 1300) return false;
    } else if (i == CH_MODE || i == CH_LOCKOUT) {
      if (data.rxCenter[i] < 800 || data.rxCenter[i] > 2200) return false;
    } else {
      if (data.rxCenter[i] < 1200 || data.rxCenter[i] > 1800) return false;
      if (!(data.rxMin[i] < data.rxCenter[i] && data.rxCenter[i] < data.rxMax[i])) return false;
    }
  }

  if (!validDirection(data.rollDir)) return false;
  if (!validDirection(data.pitchDir)) return false;
  if (!validDirection(data.yawDir)) return false;
  if (!validDirection(data.throttleDir)) return false;

  if (abs((int)data.ch5Up - (int)data.ch5Mid) < 120) return false;
  if (abs((int)data.ch5Mid - (int)data.ch5Down) < 120) return false;
  if (abs((int)data.ch5Up - (int)data.ch5Down) < 240) return false;
  if (abs((int)data.ch6On - (int)data.ch6Off) < 250) return false;

  return true;
}

void loadCalibrationFromEEPROM() {
  ArcSetupData temp;
  EEPROM.get(EEPROM_CAL_ADDR, temp);

  if (validateCalibration(temp)) {
    cal = temp;
    calibrationFromEEPROM = true;
    Serial.println(F("EEPROM setup data found: ARC v6.5 PASS."));
  } else {
    setDefaultCalibration();
    Serial.println(F("WARNING: ARC EEPROM setup data not found/invalid. Using defaults."));
    Serial.println(F("If you already ran setup, do not fly yet. Check EEPROM version/signature/checksum."));
  }
}

uint16_t mapRawBetween(uint16_t rawPulse, int lowRaw, int highRaw) {
  long denom = max(1, abs(highRaw - lowRaw));
  long result;

  if (highRaw >= lowRaw) {
    result = 1000L + ((long)((int)rawPulse - lowRaw) * 1000L) / denom;
  } else {
    result = 1000L + ((long)(lowRaw - (int)rawPulse) * 1000L) / denom;
  }

  return (uint16_t)constrain(result, 1000, 2000);
}

uint16_t calibrateCenteredAxis(byte channelIndex, uint16_t rawPulse, int8_t positiveDir) {
  int cMin = cal.rxMin[channelIndex];
  int cMid = cal.rxCenter[channelIndex];
  int cMax = cal.rxMax[channelIndex];

  long result = 1500;

  if (rawPulse >= cMid) {
    long denom = max(1, cMax - cMid);
    result = 1500L + ((long)((int)rawPulse - cMid) * 500L) / denom;
  } else {
    long denom = max(1, cMid - cMin);
    result = 1500L - ((long)(cMid - (int)rawPulse) * 500L) / denom;
  }

  result = constrain(result, 1000, 2000);

  // If setup found that positive stick movement lowers PWM,
  // invert so semantic positive always becomes >1500.
  if (positiveDir < 0) {
    result = 3000L - result;
  }

  return (uint16_t)result;
}

uint16_t nearest3Mode(uint16_t rawPulse) {
  int dUp = abs((int)rawPulse - (int)cal.ch5Up);
  int dMid = abs((int)rawPulse - (int)cal.ch5Mid);
  int dDown = abs((int)rawPulse - (int)cal.ch5Down);

  if (dUp <= dMid && dUp <= dDown) return 2000;     // Normal
  if (dMid <= dUp && dMid <= dDown) return 1500;    // Test
  return 1000;                                      // Bench
}

uint16_t nearestLockout(uint16_t rawPulse) {
  int dOn = abs((int)rawPulse - (int)cal.ch6On);
  int dOff = abs((int)rawPulse - (int)cal.ch6Off);

  return (dOn < dOff) ? 2000 : 1000;
}

uint16_t calibrateReceiverPulse(byte channelIndex, uint16_t rawPulse) {
  if (channelIndex > 5) return rawPulse;

  switch (channelIndex) {
    case CH_ROLL:
      return calibrateCenteredAxis(channelIndex, rawPulse, cal.rollDir);

    case CH_PITCH:
      return calibrateCenteredAxis(channelIndex, rawPulse, cal.pitchDir);

    case CH_YAW:
      return calibrateCenteredAxis(channelIndex, rawPulse, cal.yawDir);

    case CH_THROTTLE: {
      int lowRaw = (cal.throttleDir > 0) ? cal.rxMin[CH_THROTTLE] : cal.rxMax[CH_THROTTLE];
      int highRaw = (cal.throttleDir > 0) ? cal.rxMax[CH_THROTTLE] : cal.rxMin[CH_THROTTLE];
      return mapRawBetween(rawPulse, lowRaw, highRaw);
    }

    case CH_MODE:
      return nearest3Mode(rawPulse);

    case CH_LOCKOUT:
      return nearestLockout(rawPulse);
  }

  return rawPulse;
}

int16_t stickAxisFromPulse(uint16_t pulse) {
  int16_t centered = (int16_t)pulse - 1500;

  if (abs(centered) <= STICK_DEADBAND_US) {
    return 0;
  }

  if (centered > 0) centered -= STICK_DEADBAND_US;
  else centered += STICK_DEADBAND_US;

  return constrain(centered, -500, 500);
}

void resetPID() {
  pid_i_mem_roll = 0.0f;
  pid_i_mem_pitch = 0.0f;
  pid_i_mem_yaw = 0.0f;

  pid_output_roll = 0.0f;
  pid_output_pitch = 0.0f;
  pid_output_yaw = 0.0f;

  roll_cmd = 0.0f;
  pitch_cmd = 0.0f;
  yaw_cmd = 0.0f;

  last_yaw_error = 0.0f;
  lastPidMicros = 0;

  heading_lock_active = false;
  yawCenteredSinceMs = 0;
  heading_error = 0.0f;
}

// ================================================================
// RECEIVER PIN-CHANGE INTERRUPTS
// ================================================================

void processRxEdge(byte channelIndex, bool pinHigh, uint32_t now) {
  if (pinHigh) {
    rx.rise_time[channelIndex] = now;
  } else {
    uint32_t width = now - rx.rise_time[channelIndex];

    if (width >= RX_MIN_VALID && width <= RX_MAX_VALID) {
      rx.current_pulse[channelIndex] = (uint16_t)width;
      rx.last_update[channelIndex] = now;
    }
  }
}

ISR(PCINT2_vect) {
  uint8_t current = PIND;
  uint8_t changed = current ^ lastPINDState;
  uint32_t now = micros();

  // D7 = CH1 Roll = PIND bit 7
  if (changed & _BV(7)) {
    processRxEdge(0, current & _BV(7), now);
  }

  // D5 = CH3 Throttle = PIND bit 5
  if (changed & _BV(5)) {
    processRxEdge(2, current & _BV(5), now);
  }

  // D4 = CH4 Yaw = PIND bit 4
  if (changed & _BV(4)) {
    processRxEdge(3, current & _BV(4), now);
  }

  // D3 = CH5 Mode = PIND bit 3
  if (changed & _BV(3)) {
    processRxEdge(4, current & _BV(3), now);
  }

  lastPINDState = current;
}

ISR(PCINT0_vect) {
  uint8_t current = PINB;
  uint8_t changed = current ^ lastPINBState;
  uint32_t now = micros();

  // D8 = CH2 Pitch = PINB bit 0
  if (changed & _BV(0)) {
    processRxEdge(1, current & _BV(0), now);
  }

  // D12 = CH6 Lockout = PINB bit 4
  if (changed & _BV(4)) {
    processRxEdge(5, current & _BV(4), now);
  }

  lastPINBState = current;
}

void configureReceiverInterrupts() {
  pinMode(RX_CH1_PIN, INPUT);
  pinMode(RX_CH2_PIN, INPUT);
  pinMode(RX_CH3_PIN, INPUT);
  pinMode(RX_CH4_PIN, INPUT);
  pinMode(RX_CH5_PIN, INPUT);
  pinMode(RX_CH6_PIN, INPUT);

  for (byte i = 0; i < 6; i++) {
    rx.current_pulse[i] = 1500;
    rx.rise_time[i] = 0;
    rx.last_update[i] = 0;
  }

  rx.current_pulse[2] = 1000; // Throttle safe default.
  rx.current_pulse[4] = 1000; // Bench mode safe default.
  rx.current_pulse[5] = 1000; // CH6 safe default.

  noInterrupts();

  lastPINDState = PIND;
  lastPINBState = PINB;

  // Enable Pin Change Interrupt group for D0-D7 and D8-D13.
  PCICR |= _BV(PCIE2); // Port D
  PCICR |= _BV(PCIE0); // Port B

  // PCMSK2: D3, D4, D5, D7.
  PCMSK2 |= _BV(3); // D3 CH5
  PCMSK2 |= _BV(4); // D4 CH4
  PCMSK2 |= _BV(5); // D5 CH3
  PCMSK2 |= _BV(7); // D7 CH1

  // PCMSK0: D8, D12.
  PCMSK0 |= _BV(0); // D8 CH2
  PCMSK0 |= _BV(4); // D12 CH6

  // Clear pending interrupt flags.
  PCIFR |= _BV(PCIF2);
  PCIFR |= _BV(PCIF0);

  interrupts();
}

void copyAndCalibrateReceiver() {
  uint16_t raw[6];
  uint32_t lastUpdate[6];

  noInterrupts();
  for (byte i = 0; i < 6; i++) {
    raw[i] = rx.current_pulse[i];
    lastUpdate[i] = rx.last_update[i];
  }
  interrupts();

  uint32_t now = micros();
  receiver_ok = true;

  for (byte i = 0; i < 6; i++) {
    if (!pulseInValidRange(raw[i])) {
      receiver_ok = false;
    }

    if (lastUpdate[i] == 0 || (uint32_t)(now - lastUpdate[i]) > RX_TIMEOUT_US) {
      receiver_ok = false;
    }

    ch[i] = calibrateReceiverPulse(i, raw[i]);
  }
}

// ================================================================
// BMP280 / BME280 BAROMETER TELEMETRY MODULE
// ================================================================

bool writeI2CRegister(byte address, byte reg, byte data) {
  Wire.beginTransmission(address);
  Wire.write(reg);
  Wire.write(data);
  return Wire.endTransmission() == 0;
}

bool readI2CRegisters(byte address, byte reg, byte count, uint8_t *buffer) {
  Wire.beginTransmission(address);
  Wire.write(reg);

  if (Wire.endTransmission(false) != 0) {
    return false;
  }

  uint8_t n = Wire.requestFrom((uint8_t)address, (uint8_t)count, (uint8_t)true);
  if (n != count) {
    return false;
  }

  for (byte i = 0; i < count; i++) {
    buffer[i] = Wire.read();
  }

  return true;
}

uint16_t u16le(const uint8_t *b, byte index) {
  return (uint16_t)b[index] | ((uint16_t)b[index + 1] << 8);
}

int16_t s16le(const uint8_t *b, byte index) {
  return (int16_t)u16le(b, index);
}

bool readBMP280Calibration() {
  uint8_t b[24];
  if (!readI2CRegisters(BMP280_ADDR, 0x88, 24, b)) return false;

  bmpDigT1 = u16le(b, 0);
  bmpDigT2 = s16le(b, 2);
  bmpDigT3 = s16le(b, 4);
  bmpDigP1 = u16le(b, 6);
  bmpDigP2 = s16le(b, 8);
  bmpDigP3 = s16le(b, 10);
  bmpDigP4 = s16le(b, 12);
  bmpDigP5 = s16le(b, 14);
  bmpDigP6 = s16le(b, 16);
  bmpDigP7 = s16le(b, 18);
  bmpDigP8 = s16le(b, 20);
  bmpDigP9 = s16le(b, 22);

  return bmpDigT1 != 0 && bmpDigP1 != 0;
}

float compensateTemperatureC(int32_t adcT) {
  float var1 = (((float)adcT) / 16384.0f - ((float)bmpDigT1) / 1024.0f) * ((float)bmpDigT2);
  float var2 = ((((float)adcT) / 131072.0f - ((float)bmpDigT1) / 8192.0f) *
                (((float)adcT) / 131072.0f - ((float)bmpDigT1) / 8192.0f)) * ((float)bmpDigT3);
  bmpTFine = (int32_t)(var1 + var2);
  return (var1 + var2) / 5120.0f;
}

float compensatePressurePa(int32_t adcP) {
  float var1 = ((float)bmpTFine / 2.0f) - 64000.0f;
  float var2 = var1 * var1 * ((float)bmpDigP6) / 32768.0f;
  var2 = var2 + var1 * ((float)bmpDigP5) * 2.0f;
  var2 = (var2 / 4.0f) + (((float)bmpDigP4) * 65536.0f);
  var1 = (((float)bmpDigP3) * var1 * var1 / 524288.0f + ((float)bmpDigP2) * var1) / 524288.0f;
  var1 = (1.0f + var1 / 32768.0f) * ((float)bmpDigP1);

  if (var1 == 0.0f) return 0.0f;

  float pressure = 1048576.0f - (float)adcP;
  pressure = (pressure - (var2 / 4096.0f)) * 6250.0f / var1;
  var1 = ((float)bmpDigP9) * pressure * pressure / 2147483648.0f;
  var2 = pressure * ((float)bmpDigP8) / 32768.0f;
  pressure = pressure + (var1 + var2 + ((float)bmpDigP7)) / 16.0f;
  return pressure;
}

float altitudeFromPressure(float pressurePa, float referencePa) {
  if (pressurePa <= 0.0f || referencePa <= 0.0f) return 0.0f;
  return 44330.0f * (1.0f - pow(pressurePa / referencePa, 0.19029495f));
}

bool setupBarometer() {
  uint8_t chipId = 0;
  if (!readI2CRegisters(BMP280_ADDR, 0xD0, 1, &chipId)) {
    baro.initialized = false;
    baro.ok = false;
    baro.chipId = 0;
    baro.status = BARO_NOT_FOUND;
    return false;
  }

  baro.chipId = chipId;

  if (chipId != 0x58 && chipId != 0x60) {
    baro.initialized = false;
    baro.ok = false;
    baro.status = BARO_BAD_ID;
    return false;
  }

  if (!readBMP280Calibration()) {
    baro.initialized = false;
    baro.ok = false;
    baro.status = BARO_INIT_FAIL;
    return false;
  }

  bool ok = true;
  ok &= writeI2CRegister(BMP280_ADDR, 0xF5, 0xA0); // 1000 ms standby, filter off.
  ok &= writeI2CRegister(BMP280_ADDR, 0xF4, 0x27); // Temp x1, pressure x1, normal mode.
  delay(120);

  if (!ok) {
    baro.initialized = false;
    baro.ok = false;
    baro.status = BARO_INIT_FAIL;
    return false;
  }

  baro.initialized = true;
  baro.ok = false;
  baro.status = BARO_NOT_STARTED;
  return true;
}

bool readBarometerSample() {
  uint8_t b[6];
  if (!readI2CRegisters(BMP280_ADDR, 0xF7, 6, b)) {
    baro.ok = false;
    baro.status = BARO_READ_FAIL;
    return false;
  }

  int32_t rawP = (((int32_t)b[0]) << 12) | (((int32_t)b[1]) << 4) | (((int32_t)b[2]) >> 4);
  int32_t rawT = (((int32_t)b[3]) << 12) | (((int32_t)b[4]) << 4) | (((int32_t)b[5]) >> 4);

  baro.rawPressure = rawP;
  baro.rawTemperature = rawT;
  baro.temperatureC = compensateTemperatureC(rawT);
  baro.pressurePa = compensatePressurePa(rawP);
  baro.altitudeM = altitudeFromPressure(baro.pressurePa, BARO_SEA_LEVEL_HPA * 100.0f);

  if (baro.baselinePressurePa <= 0.0f) {
    baro.baselinePressurePa = baro.pressurePa;
  }

  baro.relativeAltitudeM = altitudeFromPressure(baro.pressurePa, baro.baselinePressurePa);
  baro.ok = baro.pressurePa > 30000.0f && baro.pressurePa < 120000.0f;
  baro.status = baro.ok ? BARO_OK : BARO_READ_FAIL;
  return baro.ok;
}

void updateBarometer() {
  uint32_t now = millis();

  if (!baro.initialized) {
    if ((uint32_t)(now - lastBaroRetryMs) < BARO_RETRY_INTERVAL_MS) {
      return;
    }

    lastBaroRetryMs = now;
    if (!setupBarometer()) {
      return;
    }
  }

  if ((uint32_t)(now - baroTimer) < BARO_UPDATE_INTERVAL_MS) {
    return;
  }

  baroTimer = now;
  readBarometerSample();
}

void printBaroStatusJsonValue() {
  switch (baro.status) {
    case BARO_OK:
      Serial.print(F("OK"));
      break;
    case BARO_NOT_FOUND:
      Serial.print(F("NOT_FOUND"));
      break;
    case BARO_BAD_ID:
      Serial.print(F("BAD_ID"));
      break;
    case BARO_INIT_FAIL:
      Serial.print(F("INIT_FAIL"));
      break;
    case BARO_READ_FAIL:
      Serial.print(F("READ_FAIL"));
      break;
    case BARO_NOT_STARTED:
    default:
      Serial.print(F("NOT_STARTED"));
      break;
  }
}

// ================================================================
// MPU6050 SENSOR MODULE
// ================================================================

bool writeMPURegister(byte reg, byte data) {
  Wire.beginTransmission(MPU6050_ADDR);
  Wire.write(reg);
  Wire.write(data);
  return Wire.endTransmission() == 0;
}

bool setupMPU6050() {
  delay(100);

  bool ok = true;

  ok &= writeMPURegister(0x6B, 0x00); // Wake up.
  delay(50);

  ok &= writeMPURegister(0x1A, 0x03); // DLPF ~44 Hz gyro / ~42 Hz accel.
  ok &= writeMPURegister(0x1B, 0x08); // Gyro +/-500 dps.
  ok &= writeMPURegister(0x1C, 0x10); // Accel +/-8g.

  sensor_ok = ok;
  return ok;
}

bool readMPU6050() {
  Wire.beginTransmission(MPU6050_ADDR);
  Wire.write(0x3B);

  if (Wire.endTransmission(false) != 0) {
    sensor_ok = false;
    return false;
  }

  uint8_t bytes = Wire.requestFrom((uint8_t)MPU6050_ADDR, (uint8_t)14, (uint8_t)true);
  if (bytes != 14) {
    sensor_ok = false;
    return false;
  }

  acc_x_raw = (int16_t)((Wire.read() << 8) | Wire.read());
  acc_y_raw = (int16_t)((Wire.read() << 8) | Wire.read());
  acc_z_raw = (int16_t)((Wire.read() << 8) | Wire.read());

  // Temperature ignored.
  Wire.read();
  Wire.read();

  gyro_x_raw = (int16_t)((Wire.read() << 8) | Wire.read());
  gyro_y_raw = (int16_t)((Wire.read() << 8) | Wire.read());
  gyro_z_raw = (int16_t)((Wire.read() << 8) | Wire.read());

  sensor_ok = true;
  return true;
}

void calibrateGyroAtBootIfNeeded() {
  // If EEPROM calibration is valid, use it.
  if (calibrationFromEEPROM) {
    gyro_calibrated = true;
    return;
  }

  Serial.println(F("EEPROM calibration not found. Taking stationary gyro average..."));
  Serial.println(F("Keep UAV still. Motors must be disarmed."));

  long sumX = 0;
  long sumY = 0;
  long sumZ = 0;
  const int samples = 2000;

  for (int i = 0; i < samples; i++) {
    if (!readMPU6050()) {
      gyro_calibrated = false;
      sensor_ok = false;
      return;
    }

    sumX += gyro_x_raw;
    sumY += gyro_y_raw;
    sumZ += gyro_z_raw;

    if (i % 100 == 0) {
      digitalWrite(STATUS_LED_PIN, !digitalRead(STATUS_LED_PIN));
    }

    delay(1);
  }

  cal.gyroOffset[0] = sumX / samples;
  cal.gyroOffset[1] = sumY / samples;
  cal.gyroOffset[2] = sumZ / samples;

  gyro_calibrated = true;

  Serial.println(F("Temporary gyro average complete. Not written to EEPROM."));
}

void updateAngles() {
  if (!readMPU6050()) return;

  uint32_t now = micros();

  float dt = 0.004f;
  if (lastImuMicros != 0) {
    dt = (float)(now - lastImuMicros) / 1000000.0f;
    if (dt <= 0.0f || dt > 0.05f) dt = 0.004f;
  }

  lastImuMicros = now;

  float sensorRollRate = (float)(gyro_x_raw - cal.gyroOffset[0]) / GYRO_SCALE_500DPS;
  float sensorPitchRate = (float)(gyro_y_raw - cal.gyroOffset[1]) / GYRO_SCALE_500DPS;

#if SWAP_ROLL_PITCH_AXES
  gyro_roll_rate = ROLL_ANGLE_SIGN * sensorPitchRate;
  gyro_pitch_rate = PITCH_ANGLE_SIGN * sensorRollRate;
#else
  gyro_roll_rate = ROLL_ANGLE_SIGN * sensorRollRate;
  gyro_pitch_rate = PITCH_ANGLE_SIGN * sensorPitchRate;
#endif
  gyro_yaw_rate = YAW_RATE_SIGN * ((float)(gyro_z_raw - cal.gyroOffset[2]) / GYRO_SCALE_500DPS);

  float ax = (float)acc_x_raw / ACC_SCALE_8G;
  float ay = (float)acc_y_raw / ACC_SCALE_8G;
  float az = (float)acc_z_raw / ACC_SCALE_8G;

  float sensorAccRoll = atan2(ay, az) * 57.2957795f;
  float sensorAccPitch = atan2(-ax, sqrt((ay * ay) + (az * az))) * 57.2957795f;

#if SWAP_ROLL_PITCH_AXES
  float accRoll = ROLL_ANGLE_SIGN * sensorAccPitch;
  float accPitch = PITCH_ANGLE_SIGN * sensorAccRoll;
#else
  float accRoll = ROLL_ANGLE_SIGN * sensorAccRoll;
  float accPitch = PITCH_ANGLE_SIGN * sensorAccPitch;
#endif

  if (firstAngle) {
    angle_roll = accRoll;
    angle_pitch = accPitch;
    firstAngle = false;
  } else {
    angle_roll = (COMPLEMENTARY_GYRO_WEIGHT * (angle_roll + gyro_roll_rate * dt)) +
                 (COMPLEMENTARY_ACC_WEIGHT * accRoll);

    angle_pitch = (COMPLEMENTARY_GYRO_WEIGHT * (angle_pitch + gyro_pitch_rate * dt)) +
                  (COMPLEMENTARY_ACC_WEIGHT * accPitch);
  }
}

// ================================================================
// COMPASS / HEADING HOLD MODULE
// ================================================================
//
// Compass failure is NON-FATAL by request:
//   - Does not disarm.
//   - Does not cut ESC output.
//   - Disables heading hold.
//   - Sends compassOK=0 and compassStatus to WMS.
//
// V6.6C finding:
//   Your 0x2C device returns magX=128, magY=0, magZ=0 when read using the
//   old QMC5883L register map. That 128 is actually 0x80, the QMC5883P chip ID,
//   because QMC5883P uses:
//     chip ID       = register 0x00, expected 0x80
//     data X/Y/Z    = registers 0x01..0x06, little-endian
//     status        = register 0x09
//     control 1     = register 0x0A
//     control 2     = register 0x0B
//
//   So this version uses the QMC5883P map first for address 0x2C.
//   HMC5883L normally uses address 0x1E, so the 0x2C module is almost certainly
//   a QMC5883P-style clone/replacement despite being sold as HMC5883L/HW-127.

bool writeCompassRegister(byte reg, byte data) {
  Wire.beginTransmission(COMPASS_ADDR);
  Wire.write(reg);
  Wire.write(data);
  return Wire.endTransmission() == 0;
}

bool readCompassRegisters(byte reg, byte count, uint8_t *buffer) {
  Wire.beginTransmission(COMPASS_ADDR);
  Wire.write(reg);

  if (Wire.endTransmission(false) != 0) {
    return false;
  }

  uint8_t n = Wire.requestFrom((uint8_t)COMPASS_ADDR, (uint8_t)count, (uint8_t)true);
  if (n != count) {
    return false;
  }

  for (byte i = 0; i < count; i++) {
    buffer[i] = Wire.read();
  }

  return true;
}

bool readCompassRegister(byte reg, uint8_t &value) {
  return readCompassRegisters(reg, 1, &value);
}

bool compassDataLooksValid(int16_t mx, int16_t my, int16_t mz) {
  compassBadReason = 0;

  // 1 = all zero / no useful data.
  if (mx == 0 && my == 0 && mz == 0) {
    compassBadReason = 1;
    return false;
  }

  // 2 = saturated / invalid signed output.
  if (mx == 32767 || my == 32767 || mz == 32767 ||
      mx == -32768 || my == -32768 || mz == -32768) {
    compassBadReason = 2;
    return false;
  }

  long ax = abs(mx);
  long ay = abs(my);
  long az = abs(mz);
  long activity = ax + ay + az;

  // 3 = activity too tiny.
  if (activity < 20) {
    compassBadReason = 3;
    return false;
  }

  // Heading hold needs changing X/Y data.
  // Do not accept one-axis-only values like X=128,Y=0,Z=0.
  byte activeAxes = 0;
  if (ax > 10) activeAxes++;
  if (ay > 10) activeAxes++;
  if (az > 10) activeAxes++;

  if (activeAxes < 2) {
    compassBadReason = 4;
    return false;
  }

  long horizontal = ax + ay;
  if (horizontal < 20) {
    compassBadReason = 5;
    return false;
  }

  return true;
}

bool setupCompassQMC5883P() {
  uint8_t id = 0;
  bool idRead = readCompassRegister(0x00, id);
  compass_chip_id = idRead ? id : 0;

  // QMC5883P expected chip ID is 0x80.
  // If it is not 0x80, still do not cut anything; just report init fail.
  if (!idRead || id != 0x80) {
    compass_driver = COMPASS_DRIVER_NONE;
    compass_status = COMPASS_INIT_FAIL;
    compass_ok = false;
    heading_lock_active = false;
    return false;
  }

  bool ok = true;

  // QMC5883P init based on the QMC5883P register map:
  //   0x0D = 0x40
  //   0x29 = 0x06
  //   0x0A = 0xCF : 200Hz, continuous, +/-2G style configuration
  //   0x0B = 0x00
  ok &= writeCompassRegister(0x0D, 0x40);
  ok &= writeCompassRegister(0x29, 0x06);
  ok &= writeCompassRegister(0x0A, 0xCF);
  ok &= writeCompassRegister(0x0B, 0x00);

  if (!ok) {
    compass_driver = COMPASS_DRIVER_NONE;
    compass_status = COMPASS_INIT_FAIL;
    compass_ok = false;
    heading_lock_active = false;
    return false;
  }

  compass_initialized = true;
  compass_driver = COMPASS_DRIVER_QMCP;
  compass_status = COMPASS_NOT_STARTED;
  return true;
}

bool readCompassRawQMC5883P(int16_t &mx, int16_t &my, int16_t &mz) {
  uint8_t b[6];

  // QMC5883P data registers start at 0x01, not 0x00.
  // 0x00 is chip ID, which is why the previous code kept showing X=128.
  if (!readCompassRegisters(0x01, 6, b)) {
    return false;
  }

  mx = (int16_t)((b[1] << 8) | b[0]);
  my = (int16_t)((b[3] << 8) | b[2]);
  mz = (int16_t)((b[5] << 8) | b[4]);

  return true;
}

bool setupCompass() {
  return setupCompassQMC5883P();
}

void updateCompass() {
  uint32_t now = millis();

  if ((uint32_t)(now - lastCompassUpdateMs) < COMPASS_UPDATE_INTERVAL_MS) {
    return;
  }

  lastCompassUpdateMs = now;

  if (!compass_initialized) {
    if ((uint32_t)(now - lastCompassRetryMs) < COMPASS_RETRY_INTERVAL_MS) {
      compass_ok = false;
      heading_lock_active = false;
      return;
    }

    lastCompassRetryMs = now;

    if (!setupCompass()) {
      // Non-fatal: keep flying/stabilizing without heading hold.
      compass_ok = false;
      heading_lock_active = false;
      return;
    }
  }

  int16_t mx = 0;
  int16_t my = 0;
  int16_t mz = 0;

  if (!readCompassRawQMC5883P(mx, my, mz)) {
    compass_ok = false;
    compass_status = COMPASS_READ_FAIL;
    heading_lock_active = false;
    return;
  }

  if (!compassDataLooksValid(mx, my, mz)) {
    compass_ok = false;

    if (compassBadReason == 4) {
      compass_status = COMPASS_ONE_AXIS_ONLY;
    } else {
      compass_status = COMPASS_BAD_DATA;
    }

    heading_lock_active = false;
    mag_x_raw = mx;
    mag_y_raw = my;
    mag_z_raw = mz;
    return;
  }

  // Detect a suspicious flatline. A compass should not return exactly the same
  // values forever while the UAV is being moved/yawed.
  if (mx == last_mag_x_raw && my == last_mag_y_raw && mz == last_mag_z_raw) {
    if (compassFlatlineCount < 65000) compassFlatlineCount++;
  } else {
    compassFlatlineCount = 0;
  }

  last_mag_x_raw = mx;
  last_mag_y_raw = my;
  last_mag_z_raw = mz;

  if (compassFlatlineCount > 100) {
    compass_ok = false;
    compass_status = COMPASS_FLATLINED;
    heading_lock_active = false;

    mag_x_raw = mx;
    mag_y_raw = my;
    mag_z_raw = mz;
    return;
  }

  mag_x_raw = mx;
  mag_y_raw = my;
  mag_z_raw = mz;

  // Basic flat heading. Tilt compensation can be added later.
  compass_heading = wrap360(atan2((float)my, (float)mx) * 57.2957795f);

  compass_ok = true;
  compass_status = COMPASS_OK;
}

void updateHeadingHoldFromYawStick(int16_t yawStick) {
  // Manual yaw always has priority.
  if (abs(yawStick) > STICK_DEADBAND_US) {
    heading_lock_active = false;
    yawCenteredSinceMs = 0;
    heading_target = compass_heading;
    heading_error = 0.0f;
    return;
  }

  // Compass unavailable: keep yaw-rate damping/manual behavior only.
  if (!compass_ok) {
    heading_lock_active = false;
    yawCenteredSinceMs = 0;
    heading_error = 0.0f;
    return;
  }

  uint32_t now = millis();

  if (!heading_lock_active) {
    if (yawCenteredSinceMs == 0) {
      yawCenteredSinceMs = now;
      heading_target = compass_heading;
    }

    if ((uint32_t)(now - yawCenteredSinceMs) >= HEADING_LOCK_DELAY_MS) {
      heading_target = compass_heading;
      heading_lock_active = true;
    }

    heading_error = 0.0f;
    return;
  }

  heading_error = shortestAngleError(heading_target, compass_heading);

  if (fabs(heading_error) < HEADING_HOLD_DEADBAND_DEG) {
    heading_error = 0.0f;
  }

  yaw_cmd = constrainFloat(
    HEADING_HOLD_SIGN * heading_error * HEADING_HOLD_P_GAIN,
    -HEADING_HOLD_MAX_RATE_DPS,
    HEADING_HOLD_MAX_RATE_DPS
  );
}

// ================================================================
// BATTERY MONITOR MODULE
// ================================================================

uint8_t estimateBatterySoc(float monitorVoltage) {
  float usableRange = BATTERY_PERCENT_FULL_V - BATTERY_PERCENT_EMPTY_V;
  if (usableRange <= 0.0f) return 0;

  float percent = ((monitorVoltage - BATTERY_PERCENT_EMPTY_V) / usableRange) * 100.0f;
  percent = constrainFloat(percent, 0.0f, 100.0f);
  return (uint8_t)(percent + 0.5f);
}

BatteryAlarmLevel classifyBatteryAlarm(float socPercent) {
  if (socPercent <= batteryEmergencyThreshold) return BATTERY_ALARM_EMERGENCY;
  if (socPercent <= batteryCriticalThreshold) return BATTERY_ALARM_CRITICAL;
  if (socPercent <= batteryLowThreshold) return BATTERY_ALARM_LOW;
  return BATTERY_ALARM_OK;
}

void updateBatteryMonitor() {
  if (!BATTERY_MONITOR_ENABLED) {
    battery.monitorVoltage = 0.0f;
    battery.socPercent = 0;
    battery.alarm = BATTERY_ALARM_OK;
    battery.valid = false;
    batteryFailsafeActive = false;
    return;
  }

  uint32_t now = millis();
  if (batteryFilterReady && (uint32_t)(now - batteryTimer) < BATTERY_SAMPLE_INTERVAL_MS) {
    return;
  }

  batteryTimer = now;

  int raw = analogRead(BATTERY_SENSE_PIN);
  float adcVoltage = ((float)raw * BATTERY_ADC_REFERENCE_V) / BATTERY_ADC_MAX_COUNTS;

  if (!batteryFilterReady) {
    battery.monitorVoltage = adcVoltage;
    batteryFilterReady = true;
  } else {
    battery.monitorVoltage += BATTERY_FILTER_ALPHA * (adcVoltage - battery.monitorVoltage);
  }

  battery.valid = battery.monitorVoltage >= BATTERY_MIN_VALID_V && battery.monitorVoltage <= BATTERY_MAX_VALID_V;

  if (battery.valid) {
    battery.socPercent = estimateBatterySoc(battery.monitorVoltage);
    battery.alarm = classifyBatteryAlarm((float)battery.socPercent);
  } else {
    battery.socPercent = 0;
    battery.alarm = BATTERY_ALARM_EMERGENCY;
  }

  batteryFailsafeActive = battery.alarm == BATTERY_ALARM_EMERGENCY || !battery.valid;
}

bool batteryPrearmOk() {
  if (!BATTERY_MONITOR_ENABLED) return true;
  return battery.valid && battery.alarm == BATTERY_ALARM_OK;
}

bool thresholdCommandValuesValid(float low, float critical, float emergency) {
  return emergency >= 0.0f &&
         emergency < critical &&
         critical < low &&
         low <= 100.0f;
}

bool readCommandFloat(const char *command, const char *key, float &value) {
  const char *start = strstr(command, key);
  if (start == NULL) return false;

  value = (float)atof(start + strlen(key));
  return true;
}

void handleBatteryCommand(const char *command) {
  if (strncmp(command, "BAT:", 4) != 0) return;

  float low = batteryLowThreshold;
  float critical = batteryCriticalThreshold;
  float emergency = batteryEmergencyThreshold;

  bool hasLow = readCommandFloat(command, "LOW=", low);
  bool hasCritical = readCommandFloat(command, "CRIT=", critical);
  bool hasEmergency = readCommandFloat(command, "EMERG=", emergency);

  if (!hasLow && !hasCritical && !hasEmergency) {
    Serial.println(F("ERR:BAT_COMMAND_EMPTY"));
    return;
  }

  if (!thresholdCommandValuesValid(low, critical, emergency)) {
    Serial.println(F("ERR:BAT_THRESHOLD_RANGE"));
    return;
  }

  batteryLowThreshold = low;
  batteryCriticalThreshold = critical;
  batteryEmergencyThreshold = emergency;

  Serial.print(F("ACK:BAT,LOW="));
  Serial.print(batteryLowThreshold, 2);
  Serial.print(F(",CRIT="));
  Serial.print(batteryCriticalThreshold, 2);
  Serial.print(F(",EMERG="));
  Serial.println(batteryEmergencyThreshold, 2);
}

bool pidCommandValuesValid(float kp, float ki, float kd) {
  return kp >= 0.0f && kp <= PID_P_GAIN_MAX &&
         ki >= 0.0f && ki <= PID_I_GAIN_MAX &&
         kd >= 0.0f && kd <= PID_D_GAIN_MAX;
}

void handlePidCommand(const char *command) {
  if (strncmp(command, "PID:", 4) != 0) return;

  float kpr = pid_p_gain_roll;
  float kir = pid_i_gain_roll;
  float kdr = pid_d_gain_roll;
  float kpp = pid_p_gain_pitch;
  float kip = pid_i_gain_pitch;
  float kdp = pid_d_gain_pitch;
  float kpy = pid_p_gain_yaw;
  float kiy = pid_i_gain_yaw;
  float kdy = pid_d_gain_yaw;

  bool hasRollP = readCommandFloat(command, "KPR=", kpr);
  bool hasRollI = readCommandFloat(command, "KIR=", kir);
  bool hasRollD = readCommandFloat(command, "KDR=", kdr);
  bool hasPitchP = readCommandFloat(command, "KPP=", kpp);
  bool hasPitchI = readCommandFloat(command, "KIP=", kip);
  bool hasPitchD = readCommandFloat(command, "KDP=", kdp);
  bool hasYawP = readCommandFloat(command, "KPY=", kpy);
  bool hasYawI = readCommandFloat(command, "KIY=", kiy);
  bool hasYawD = readCommandFloat(command, "KDY=", kdy);

  if (!hasRollP && !hasRollI && !hasRollD &&
      !hasPitchP && !hasPitchI && !hasPitchD &&
      !hasYawP && !hasYawI && !hasYawD) {
    Serial.println(F("ERR:PID_COMMAND_EMPTY"));
    return;
  }

  // Backwards compatibility: old dashboard command only sent roll KPR/KIR/KDR.
  if ((hasRollP || hasRollI || hasRollD) &&
      !hasPitchP && !hasPitchI && !hasPitchD &&
      !hasYawP && !hasYawI && !hasYawD) {
    kpp = kpr;
    kip = kir;
    kdp = kdr;
    kpy = kpr;
    kiy = kir;
    kdy = kdr;
  }

  if (!pidCommandValuesValid(kpr, kir, kdr) ||
      !pidCommandValuesValid(kpp, kip, kdp) ||
      !pidCommandValuesValid(kpy, kiy, kdy)) {
    Serial.println(F("ERR:PID_RANGE"));
    return;
  }

  pid_p_gain_roll = kpr;
  pid_i_gain_roll = kir;
  pid_d_gain_roll = kdr;
  pid_p_gain_pitch = kpp;
  pid_i_gain_pitch = kip;
  pid_d_gain_pitch = kdp;
  pid_p_gain_yaw = kpy;
  pid_i_gain_yaw = kiy;
  pid_d_gain_yaw = kdy;

  resetPID();

  Serial.print(F("ACK:PID,KPR="));
  Serial.print(pid_p_gain_roll, 3);
  Serial.print(F(",KIR="));
  Serial.print(pid_i_gain_roll, 4);
  Serial.print(F(",KDR="));
  Serial.print(pid_d_gain_roll, 3);
  Serial.print(F(",KPP="));
  Serial.print(pid_p_gain_pitch, 3);
  Serial.print(F(",KIP="));
  Serial.print(pid_i_gain_pitch, 4);
  Serial.print(F(",KDP="));
  Serial.print(pid_d_gain_pitch, 3);
  Serial.print(F(",KPY="));
  Serial.print(pid_p_gain_yaw, 3);
  Serial.print(F(",KIY="));
  Serial.print(pid_i_gain_yaw, 4);
  Serial.print(F(",KDY="));
  Serial.println(pid_d_gain_yaw, 3);
}

// ================================================================
// SAFETY / ARMING / MODE LOGIC
// ================================================================

void updateFlightModeCap() {
  // CH5 calibrated:
  //   low  around 1000 = Bench 40%, cap 1400
  //   mid  around 1500 = Test 70%, cap 1700
  //   high around 2000 = Normal full, cap 2000

  if (ch[4] < 1300) {
    esc_cap = ESC_CAP_BENCH;
  } else if (ch[4] < 1700) {
    esc_cap = ESC_CAP_TEST;
  } else {
    esc_cap = ESC_CAP_NORMAL;
  }
}

bool throttleLow() {
  return ch[2] < STICK_LOW_US;
}

bool yawRight() {
  return ch[3] > STICK_HIGH_US;
}

bool yawLeft() {
  return ch[3] < 1100;
}

bool yawCentered() {
  return ch[3] > STICK_CENTER_LOW_US && ch[3] < STICK_CENTER_HIGH_US;
}

bool safeToArm() {
  if (!receiver_ok) return false;
  if (!sensor_ok) return false;
  if (!gyro_calibrated) return false;
  if (emergencyLockoutActive) return false;
  if (!batteryPrearmOk()) return false;
  if (rearmNeutralRequired) return false;
  if (!throttleLow()) return false;

  return true;
}

void check_safety_and_arming() {
  // CH6 emergency lockout.
  // With calibrated channel values, >1500 means lockout active.
  if (ch[5] > 1500) {
    emergencyLockoutActive = true;
    rearmNeutralRequired = true;
    flight_mode = FLIGHT_DISARMED;
    resetPID();
  } else {
    emergencyLockoutActive = false;
  }

  // Receiver/sensor failure = immediate disarm.
  if (!receiver_ok || !sensor_ok || !gyro_calibrated) {
    flight_mode = FLIGHT_DISARMED;
    resetPID();
  }

  if (batteryFailsafeActive) {
    rearmNeutralRequired = true;
    flight_mode = FLIGHT_DISARMED;
    resetPID();
  }

  // After CH6 lockout release, require throttle low and yaw centered before arming is allowed.
  // This prevents instant re-arm if the stick is still sitting in the arm corner.
  if (rearmNeutralRequired && !emergencyLockoutActive && !batteryFailsafeActive && throttleLow() && yawCentered()) {
    rearmNeutralRequired = false;
  }

  // Arming sequence: throttle low + yaw right.
  if (flight_mode == FLIGHT_DISARMED && safeToArm() && yawRight()) {
    if (armStartMs == 0) armStartMs = millis();

    if ((uint32_t)(millis() - armStartMs) >= ARM_HOLD_MS) {
      flight_mode = FLIGHT_ARMED;
      resetPID();
      firstAngle = true;
    }
  } else {
    armStartMs = 0;
  }

  // Disarming sequence: throttle low + yaw left.
  if (flight_mode == FLIGHT_ARMED && throttleLow() && yawLeft()) {
    if (disarmStartMs == 0) disarmStartMs = millis();

    if ((uint32_t)(millis() - disarmStartMs) >= DISARM_HOLD_MS) {
      flight_mode = FLIGHT_DISARMED;
      resetPID();
    }
  } else {
    disarmStartMs = 0;
  }
}

// ================================================================
// PID / MIXER MODULE
// ================================================================

void calculate_pid() {
  uint32_t now = micros();
  float dt = 0.004f;

  if (lastPidMicros != 0) {
    dt = (float)(now - lastPidMicros) / 1000000.0f;
    if (dt <= 0.0f || dt > 0.05f) dt = 0.004f;
  }

  lastPidMicros = now;

  int16_t rollStick = stickAxisFromPulse(ch[0]);
  int16_t pitchStick = stickAxisFromPulse(ch[1]);
  int16_t yawStick = stickAxisFromPulse(ch[3]);

  roll_cmd = ((float)rollStick / 500.0f) * MAX_ANGLE_DEG;
  pitch_cmd = ((float)pitchStick / 500.0f) * MAX_ANGLE_DEG;

  // Manual yaw command remains highest priority.
  // If yaw stick is centered and compass is OK, heading hold may replace this with
  // a small yaw-rate command to return to the locked heading.
  yaw_cmd = ((float)yawStick / 500.0f) * MAX_YAW_RATE_DPS;
  updateHeadingHoldFromYawStick(yawStick);

  float rollError = roll_cmd - angle_roll;
  float pitchError = pitch_cmd - angle_pitch;

  // I-term uses loop time. Conservative to avoid fast wind-up.
  pid_i_mem_roll += pid_i_gain_roll * rollError * dt;
  pid_i_mem_pitch += pid_i_gain_pitch * pitchError * dt;

  pid_i_mem_roll = constrainFloat(pid_i_mem_roll, -MAX_PID_OUTPUT, MAX_PID_OUTPUT);
  pid_i_mem_pitch = constrainFloat(pid_i_mem_pitch, -MAX_PID_OUTPUT, MAX_PID_OUTPUT);

  // D-term is gyro rate damping.
  pid_output_roll = (pid_p_gain_roll * rollError) +
                    pid_i_mem_roll -
                    (pid_d_gain_roll * gyro_roll_rate);

  pid_output_pitch = (pid_p_gain_pitch * pitchError) +
                     pid_i_mem_pitch -
                     (pid_d_gain_pitch * gyro_pitch_rate);

  // Yaw-rate damping / command. No compass heading hold in this baseline.
  float yawError = yaw_cmd - gyro_yaw_rate;
  pid_i_mem_yaw += pid_i_gain_yaw * yawError * dt;
  pid_i_mem_yaw = constrainFloat(pid_i_mem_yaw, -MAX_YAW_OUTPUT, MAX_YAW_OUTPUT);

  pid_output_yaw = (pid_p_gain_yaw * yawError) +
                   pid_i_mem_yaw +
                   (pid_d_gain_yaw * ((yawError - last_yaw_error) / dt));

  last_yaw_error = yawError;

  pid_output_roll = constrainFloat(pid_output_roll, -MAX_PID_OUTPUT, MAX_PID_OUTPUT);
  pid_output_pitch = constrainFloat(pid_output_pitch, -MAX_PID_OUTPUT, MAX_PID_OUTPUT);
  pid_output_yaw = constrainFloat(pid_output_yaw, -MAX_YAW_OUTPUT, MAX_YAW_OUTPUT);
}

void mixMotors() {
  int throttle = ch[2];

  if (throttle < ESC_IDLE_US) {
    throttle = ESC_IDLE_US;
  }

  throttle = constrain(throttle, ESC_MIN_US, esc_cap);

  float rollMix = MIX_ROLL_SIGN * pid_output_roll;
  float pitchMix = MIX_PITCH_SIGN * pid_output_pitch;
  float yawMix = MIX_YAW_SIGN * pid_output_yaw;

  /*
    Motor layout used:
      M1 = Front Right
      M4 = Front Left
      M2 = Rear Right
      M3 = Rear Left

    Mixer convention:
      Positive roll error produces negative rollMix and raises the right motors.
      Positive pitch error produces negative pitchMix and raises the front motors.
      Positive yawMix follows yaw correction direction.

    If the UAV fights itself, do not tune PID first.
    First flip MIX_ROLL_SIGN / MIX_PITCH_SIGN / MIX_YAW_SIGN.
  */

  esc_1 = throttle - pitchMix - rollMix + yawMix; // M1 Front Right
  esc_2 = throttle + pitchMix - rollMix - yawMix; // M2 Rear Right
  esc_3 = throttle + pitchMix + rollMix + yawMix; // M3 Rear Left
  esc_4 = throttle - pitchMix + rollMix - yawMix; // M4 Front Left

  esc_1 = constrain(esc_1, ESC_MIN_US, esc_cap);
  esc_2 = constrain(esc_2, ESC_MIN_US, esc_cap);
  esc_3 = constrain(esc_3, ESC_MIN_US, esc_cap);
  esc_4 = constrain(esc_4, ESC_MIN_US, esc_cap);
}

// ================================================================
// ESC OUTPUT MODULE
// ================================================================

void configureEscPins() {
  pinMode(ESC1_PIN, OUTPUT);
  pinMode(ESC2_PIN, OUTPUT);
  pinMode(ESC3_PIN, OUTPUT);
  pinMode(ESC4_PIN, OUTPUT);

  digitalWrite(ESC1_PIN, LOW);
  digitalWrite(ESC2_PIN, LOW);
  digitalWrite(ESC3_PIN, LOW);
  digitalWrite(ESC4_PIN, LOW);
}

void forceMotorsOff() {
  esc_1 = ESC_MIN_US;
  esc_2 = ESC_MIN_US;
  esc_3 = ESC_MIN_US;
  esc_4 = ESC_MIN_US;
}

void writeEscPulses() {
  // ESC pins:
  //   D6  = PORTD bit 6
  //   D9  = PORTB bit 1
  //   D10 = PORTB bit 2
  //   D11 = PORTB bit 3

  uint16_t p1 = constrainPulse(esc_1);
  uint16_t p2 = constrainPulse(esc_2);
  uint16_t p3 = constrainPulse(esc_3);
  uint16_t p4 = constrainPulse(esc_4);

  uint32_t start = micros();

  PORTD |= _BV(6);                         // D6 high.
  PORTB |= _BV(1) | _BV(2) | _BV(3);       // D9/D10/D11 high.

  bool e1High = true;
  bool e2High = true;
  bool e3High = true;
  bool e4High = true;

  while (e1High || e2High || e3High || e4High) {
    uint32_t elapsed = micros() - start;

    if (e1High && elapsed >= p1) {
      PORTD &= ~_BV(6);
      e1High = false;
    }

    if (e2High && elapsed >= p2) {
      PORTB &= ~_BV(1);
      e2High = false;
    }

    if (e3High && elapsed >= p3) {
      PORTB &= ~_BV(2);
      e3High = false;
    }

    if (e4High && elapsed >= p4) {
      PORTB &= ~_BV(3);
      e4High = false;
    }
  }
}

// ================================================================
// LED STATUS MODULE
// ================================================================

void updateStatusLED(LedState state) {
  uint32_t now = millis();

  if (state == LED_ARMED) {
    digitalWrite(STATUS_LED_PIN, HIGH);
    return;
  }

  if (state == LED_READY) {
    // Slow strobe blink.
    if ((uint32_t)(now - ledTimer) >= 800) {
      digitalWrite(STATUS_LED_PIN, !digitalRead(STATUS_LED_PIN));
      ledTimer = now;
    }
    return;
  }

  if (state == LED_LOCKOUT || state == LED_NOT_READY) {
    // Fast blink.
    if ((uint32_t)(now - ledTimer) >= 120) {
      digitalWrite(STATUS_LED_PIN, !digitalRead(STATUS_LED_PIN));
      ledTimer = now;
    }
    return;
  }

  if (state == LED_ERROR) {
    // Urgent double-blink pattern.
    uint16_t phase = now % 600;

    if (phase < 80 || (phase >= 160 && phase < 240)) {
      digitalWrite(STATUS_LED_PIN, HIGH);
    } else {
      digitalWrite(STATUS_LED_PIN, LOW);
    }
    return;
  }
}

LedState getLedState() {
  if (emergencyLockoutActive) return LED_LOCKOUT;
  if (!receiver_ok || !sensor_ok || !gyro_calibrated || batteryFailsafeActive || loopOverrun) return LED_ERROR;
  if (flight_mode == FLIGHT_ARMED) return LED_ARMED;
  if (safeToArm()) return LED_READY;
  return LED_NOT_READY;
}

// ================================================================
// SERIAL / TELEMETRY / TUNING
// ================================================================
//
// The monitoring portal in your screenshot is expecting JSON-style packets.
// This prints one complete JSON packet per line. The dashboard can parse it,
// and the Arduino Serial Monitor can still show it directly.
//
// Motor output notes:
//   esc_1 = D6  = M1
//   esc_2 = D9  = M2
//   esc_3 = D10 = M3
//   esc_4 = D11 = M4
//
// Physical map used by this flight controller:
//   mFR = esc_1 / D6
//   mBR = esc_2 / D9
//   mBL = esc_3 / D10
//   mFL = esc_4 / D11
//
// I also print d6/d9/d10/d11 and m1/m2/m3/m4 so there is no ambiguity.

void printModeName() {
  if (esc_cap == ESC_CAP_BENCH) Serial.print(F("Bench"));
  else if (esc_cap == ESC_CAP_TEST) Serial.print(F("Test"));
  else Serial.print(F("Normal"));
}

void printModeJsonValue() {
  if (!receiver_ok) {
    Serial.print(F("-"));
  } else if (esc_cap == ESC_CAP_BENCH) {
    Serial.print(F("BENCH"));
  } else if (esc_cap == ESC_CAP_TEST) {
    Serial.print(F("TEST"));
  } else {
    Serial.print(F("NORMAL"));
  }
}

void printStateJsonValue() {
  if (flight_mode == FLIGHT_ARMED) {
    Serial.print(F("ARMED"));
  } else if (emergencyLockoutActive) {
    Serial.print(F("LOCKOUT"));
  } else if (!receiver_ok) {
    Serial.print(F("RX_FAIL"));
  } else if (!sensor_ok) {
    Serial.print(F("SENSOR_FAIL"));
  } else if (!gyro_calibrated) {
    Serial.print(F("GYRO_NOT_CAL"));
  } else if (BATTERY_MONITOR_ENABLED && !battery.valid) {
    Serial.print(F("BATTERY_INVALID"));
  } else if (battery.alarm == BATTERY_ALARM_EMERGENCY) {
    Serial.print(F("BATTERY_EMERGENCY"));
  } else if (battery.alarm == BATTERY_ALARM_CRITICAL) {
    Serial.print(F("BATTERY_CRITICAL"));
  } else if (battery.alarm == BATTERY_ALARM_LOW) {
    Serial.print(F("BATTERY_LOW"));
  } else if (rearmNeutralRequired) {
    Serial.print(F("CENTER_YAW"));
  } else if (safeToArm()) {
    Serial.print(F("READY"));
  } else {
    Serial.print(F("NOT_READY"));
  }
}

void printLedJsonValue() {
  LedState led = getLedState();

  if (led == LED_ARMED) Serial.print(F("ARMED"));
  else if (led == LED_READY) Serial.print(F("READY"));
  else if (led == LED_LOCKOUT) Serial.print(F("LOCKOUT"));
  else if (led == LED_ERROR) Serial.print(F("ERROR"));
  else Serial.print(F("NOT_READY"));
}

void printCompassStatusJsonValue() {
  switch (compass_status) {
    case COMPASS_OK:
      Serial.print(F("OK"));
      break;
    case COMPASS_NOT_FOUND:
      Serial.print(F("NOT_FOUND"));
      break;
    case COMPASS_INIT_FAIL:
      Serial.print(F("INIT_FAIL"));
      break;
    case COMPASS_READ_FAIL:
      Serial.print(F("READ_FAIL"));
      break;
    case COMPASS_BAD_DATA:
      Serial.print(F("BAD_DATA"));
      break;
    case COMPASS_ONE_AXIS_ONLY:
      Serial.print(F("ONE_AXIS_ONLY"));
      break;
    case COMPASS_FLATLINED:
      Serial.print(F("FLATLINED"));
      break;
    case COMPASS_NOT_STARTED:
    default:
      Serial.print(F("NOT_STARTED"));
      break;
  }
}

void printCompassDriverJsonValue() {
  if (compass_driver == COMPASS_DRIVER_HMC) Serial.print(F("HMC"));
  else if (compass_driver == COMPASS_DRIVER_QMC) Serial.print(F("QMC"));
  else if (compass_driver == COMPASS_DRIVER_QMCP) Serial.print(F("QMC5883P"));
  else Serial.print(F("NONE"));
}

int telemetryCapValue() {
  // The monitor screenshot shows cap=1000 when disarmed/booting.
  // The separate modeCap field shows the CH5-selected cap.
  if (flight_mode == FLIGHT_ARMED) return esc_cap;
  return ESC_MIN_US;
}

void printTelemetryJson() {
  int activeCap = telemetryCapValue();

  // Latest physical motor layout used in this flight-controller file.
  int mFR = esc_1; // D6,  M1, Front Right
  int mBR = esc_2; // D9,  M2, Back/Rear Right
  int mBL = esc_3; // D10, M3, Back/Rear Left
  int mFL = esc_4; // D11, M4, Front Left

  Serial.print(F("{\"ms\":"));
  Serial.print(millis());

  Serial.print(F(",\"firmware_version\":\""));
  Serial.print(FIRMWARE_VERSION);
  Serial.print(F("\",\"firmware_revision\":\""));
  Serial.print(FIRMWARE_REVISION);
  Serial.print(F("\""));

  Serial.print(F(",\"state\":\""));
  printStateJsonValue();
  Serial.print(F("\""));

  Serial.print(F(",\"armed\":"));
  Serial.print(flight_mode == FLIGHT_ARMED ? 1 : 0);

  Serial.print(F(",\"lockout\":"));
  Serial.print(emergencyLockoutActive ? 1 : 0);

  Serial.print(F(",\"failsafe\":"));
  Serial.print((emergencyLockoutActive || batteryFailsafeActive || !receiver_ok || !sensor_ok || !gyro_calibrated) ? 1 : 0);

  Serial.print(F(",\"mode\":\""));
  printModeJsonValue();
  Serial.print(F("\""));

  Serial.print(F(",\"cap\":"));
  Serial.print(activeCap);

  Serial.print(F(",\"modeCap\":"));
  Serial.print(esc_cap);

  Serial.print(F(",\"ch1\":"));
  Serial.print(ch[0]);
  Serial.print(F(",\"ch2\":"));
  Serial.print(ch[1]);
  Serial.print(F(",\"ch3\":"));
  Serial.print(ch[2]);
  Serial.print(F(",\"ch4\":"));
  Serial.print(ch[3]);
  Serial.print(F(",\"ch5\":"));
  Serial.print(ch[4]);
  Serial.print(F(",\"ch6\":"));
  Serial.print(ch[5]);

  Serial.print(F(",\"rxOK\":"));
  Serial.print(receiver_ok ? 1 : 0);

  Serial.print(F(",\"imuOK\":"));
  Serial.print(sensor_ok ? 1 : 0);

  Serial.print(F(",\"sensorsOK\":"));
  Serial.print((sensor_ok && gyro_calibrated) ? 1 : 0);

  Serial.print(F(",\"gyroCal\":"));
  Serial.print(gyro_calibrated ? 1 : 0);

  Serial.print(F(",\"battery_monitor_enabled\":"));
  Serial.print(BATTERY_MONITOR_ENABLED ? 1 : 0);
  Serial.print(F(",\"battery_voltage\":"));
  Serial.print(battery.monitorVoltage, 2);
  Serial.print(F(",\"battery_monitor_voltage\":"));
  Serial.print(battery.monitorVoltage, 2);
  Serial.print(F(",\"battery_cell_voltage\":"));
  Serial.print(0.0f, 2);
  Serial.print(F(",\"battery_soc\":"));
  Serial.print(battery.socPercent);
  Serial.print(F(",\"battery_percent\":"));
  Serial.print(battery.socPercent);
  Serial.print(F(",\"battery_alarm\":"));
  Serial.print((int)battery.alarm);
  Serial.print(F(",\"battery_valid\":"));
  Serial.print(battery.valid ? 1 : 0);
  Serial.print(F(",\"battery_empty_scale_voltage\":"));
  Serial.print(BATTERY_PERCENT_EMPTY_V, 2);
  Serial.print(F(",\"battery_full_scale_voltage\":"));
  Serial.print(BATTERY_PERCENT_FULL_V, 2);
  Serial.print(F(",\"battery_low_threshold\":"));
  Serial.print(batteryLowThreshold, 2);
  Serial.print(F(",\"battery_critical_threshold\":"));
  Serial.print(batteryCriticalThreshold, 2);
  Serial.print(F(",\"battery_emergency_threshold\":"));
  Serial.print(batteryEmergencyThreshold, 2);

  Serial.print(F(",\"compassOK\":"));
  Serial.print(compass_ok ? 1 : 0);
  Serial.print(F(",\"compassStatus\":\""));
  printCompassStatusJsonValue();
  Serial.print(F("\""));
  Serial.print(F(",\"compassDriver\":\""));
  printCompassDriverJsonValue();
  Serial.print(F("\""));
  Serial.print(F(",\"compassChipId\":"));
  Serial.print(compass_chip_id);
  Serial.print(F(",\"compassBadReason\":"));
  Serial.print(compassBadReason);
  Serial.print(F(",\"compassFlatlineCount\":"));
  Serial.print(compassFlatlineCount);

  Serial.print(F(",\"baroOK\":"));
  Serial.print(baro.ok ? 1 : 0);
  Serial.print(F(",\"baroStatus\":\""));
  printBaroStatusJsonValue();
  Serial.print(F("\""));
  Serial.print(F(",\"baroChipId\":"));
  Serial.print(baro.chipId);
  Serial.print(F(",\"baroPressurePa\":"));
  Serial.print(baro.pressurePa, 1);
  Serial.print(F(",\"baroTempC\":"));
  Serial.print(baro.temperatureC, 2);
  Serial.print(F(",\"baroAltitudeM\":"));
  Serial.print(baro.altitudeM, 2);
  Serial.print(F(",\"baroRelativeAltitudeM\":"));
  Serial.print(baro.relativeAltitudeM, 2);
  Serial.print(F(",\"baroRawPressure\":"));
  Serial.print(baro.rawPressure);
  Serial.print(F(",\"baroRawTemperature\":"));
  Serial.print(baro.rawTemperature);
  Serial.print(F(",\"baroBaselineRaw\":"));
  Serial.print(cal.baroBaselineRaw);
  Serial.print(F(",\"baroBaselinePressurePa\":"));
  Serial.print(baro.baselinePressurePa, 1);

  Serial.print(F(",\"roll\":"));
  Serial.print(angle_roll, 1);

  Serial.print(F(",\"pitch\":"));
  Serial.print(angle_pitch, 1);

  Serial.print(F(",\"gyroR\":"));
  Serial.print(gyro_roll_rate, 1);

  Serial.print(F(",\"gyroP\":"));
  Serial.print(gyro_pitch_rate, 1);

  Serial.print(F(",\"gyroY\":"));
  Serial.print(gyro_yaw_rate, 1);

  Serial.print(F(",\"heading\":"));
  Serial.print(compass_heading, 1);
  Serial.print(F(",\"headLock\":"));
  Serial.print(heading_lock_active ? 1 : 0);
  Serial.print(F(",\"headTarget\":"));
  Serial.print(heading_target, 1);
  Serial.print(F(",\"headErr\":"));
  Serial.print(heading_error, 1);
  Serial.print(F(",\"magX\":"));
  Serial.print(mag_x_raw);
  Serial.print(F(",\"magY\":"));
  Serial.print(mag_y_raw);
  Serial.print(F(",\"magZ\":"));
  Serial.print(mag_z_raw);

  Serial.print(F(",\"rollCmd\":"));
  Serial.print(roll_cmd, 1);

  Serial.print(F(",\"pitchCmd\":"));
  Serial.print(pitch_cmd, 1);

  Serial.print(F(",\"yawCmd\":"));
  Serial.print(yaw_cmd, 1);

  Serial.print(F(",\"rollOut\":"));
  Serial.print(pid_output_roll, 1);

  Serial.print(F(",\"pitchOut\":"));
  Serial.print(pid_output_pitch, 1);

  Serial.print(F(",\"yawOut\":"));
  Serial.print(pid_output_yaw, 1);

  // Live PID gain values for WMS_v3.2.
  Serial.print(F(",\"pidRollP\":"));
  Serial.print(pid_p_gain_roll, 3);
  Serial.print(F(",\"pidRollI\":"));
  Serial.print(pid_i_gain_roll, 4);
  Serial.print(F(",\"pidRollD\":"));
  Serial.print(pid_d_gain_roll, 3);

  Serial.print(F(",\"pidPitchP\":"));
  Serial.print(pid_p_gain_pitch, 3);
  Serial.print(F(",\"pidPitchI\":"));
  Serial.print(pid_i_gain_pitch, 4);
  Serial.print(F(",\"pidPitchD\":"));
  Serial.print(pid_d_gain_pitch, 3);

  Serial.print(F(",\"pidYawP\":"));
  Serial.print(pid_p_gain_yaw, 3);
  Serial.print(F(",\"pidYawI\":"));
  Serial.print(pid_i_gain_yaw, 4);
  Serial.print(F(",\"pidYawD\":"));
  Serial.print(pid_d_gain_yaw, 3);

  // Portal-friendly motor names.
  Serial.print(F(",\"mFL\":"));
  Serial.print(mFL);

  Serial.print(F(",\"mFR\":"));
  Serial.print(mFR);

  Serial.print(F(",\"mBL\":"));
  Serial.print(mBL);

  Serial.print(F(",\"mBR\":"));
  Serial.print(mBR);

  // Extra unambiguous motor/pin names.
  Serial.print(F(",\"m1\":"));
  Serial.print(esc_1);
  Serial.print(F(",\"m2\":"));
  Serial.print(esc_2);
  Serial.print(F(",\"m3\":"));
  Serial.print(esc_3);
  Serial.print(F(",\"m4\":"));
  Serial.print(esc_4);

  Serial.print(F(",\"d6\":"));
  Serial.print(esc_1);
  Serial.print(F(",\"d9\":"));
  Serial.print(esc_2);
  Serial.print(F(",\"d10\":"));
  Serial.print(esc_3);
  Serial.print(F(",\"d11\":"));
  Serial.print(esc_4);

  Serial.print(F(",\"led\":\""));
  printLedJsonValue();
  Serial.print(F("\""));

  Serial.print(F(",\"eeprom\":\""));
  Serial.print(calibrationFromEEPROM ? F("ARC") : F("DEFAULT"));
  Serial.print(F("\""));

  Serial.print(F(",\"loopOverrun\":"));
  Serial.print(loopOverrun ? 1 : 0);

  Serial.println(F("}"));
}

void handleTelemetry() {
  uint32_t now = millis();

  if ((uint32_t)(now - telemetryTimer) >= TELEMETRY_INTERVAL_MS) {
    printTelemetryJson();
    telemetryTimer = now;
  }
}

void adjustGain(float &gain, char dir, float step, float minVal, float maxVal) {
  if (dir == '+') gain += step;
  if (dir == '-') gain -= step;
  gain = constrainFloat(gain, minVal, maxVal);
}

void printGains() {
  Serial.print(F("PID gains | Roll P/I/D="));
  Serial.print(pid_p_gain_roll, 2);
  Serial.print('/');
  Serial.print(pid_i_gain_roll, 3);
  Serial.print('/');
  Serial.print(pid_d_gain_roll, 2);

  Serial.print(F(" | Pitch P/I/D="));
  Serial.print(pid_p_gain_pitch, 2);
  Serial.print('/');
  Serial.print(pid_i_gain_pitch, 3);
  Serial.print('/');
  Serial.print(pid_d_gain_pitch, 2);

  Serial.print(F(" | Yaw P/I/D="));
  Serial.print(pid_p_gain_yaw, 2);
  Serial.print('/');
  Serial.print(pid_i_gain_yaw, 3);
  Serial.print('/');
  Serial.print(pid_d_gain_yaw, 2);

  Serial.println();
}

/*
  Serial PID tuning command map for WMS_v3.2:
    r+/r- = Roll P  +/- 0.01
    i+/i- = Roll I  +/- 0.01
    d+/d- = Roll D  +/- 0.01

    R+/R- = Pitch P +/- 0.01
    I+/I- = Pitch I +/- 0.01
    D+/D- = Pitch D +/- 0.01

    y+/y- = Yaw P   +/- 0.01
    u+/u- = Yaw I   +/- 0.01
    Y+/Y- = Yaw D   +/- 0.01

    ? = print current gains
*/
void handleSerialTuning() {
  static char pending = 0;
  static char commandBuffer[160];
  static byte commandLen = 0;
  static bool collectingCommand = false;

  while (Serial.available() > 0) {
    char c = Serial.read();

    if (collectingCommand) {
      if (c == '\r') {
        continue;
      }

      if (c == '\n') {
        commandBuffer[commandLen] = '\0';
        handleBatteryCommand(commandBuffer);
        handlePidCommand(commandBuffer);
        commandLen = 0;
        collectingCommand = false;
        continue;
      }

      if (commandLen < sizeof(commandBuffer) - 1) {
        commandBuffer[commandLen++] = c;
      } else {
        commandLen = 0;
        collectingCommand = false;
        Serial.println(F("ERR:SERIAL_LINE_TOO_LONG"));
      }

      continue;
    }

    if (c == 'B' || c == 'P') {
      commandLen = 0;
      commandBuffer[commandLen++] = c;
      collectingCommand = true;
      pending = 0;
      continue;
    }

    if (c == '?') {
      printGains();
      pending = 0;
      continue;
    }

    if (pending == 0) {
      if (c == 'r' || c == 'R' || c == 'y' ||
          c == 'i' || c == 'I' || c == 'u' ||
          c == 'd' || c == 'D' || c == 'Y') {
        pending = c;
      }
    } else {
      if (c == '+' || c == '-') {
        switch (pending) {
          case 'r': adjustGain(pid_p_gain_roll, c, PID_TUNE_STEP, 0.0f, PID_P_GAIN_MAX); break;
          case 'R': adjustGain(pid_p_gain_pitch, c, PID_TUNE_STEP, 0.0f, PID_P_GAIN_MAX); break;
          case 'y': adjustGain(pid_p_gain_yaw, c, PID_TUNE_STEP, 0.0f, PID_P_GAIN_MAX); break;

          case 'i': adjustGain(pid_i_gain_roll, c, PID_TUNE_STEP, 0.0f, PID_I_GAIN_MAX); break;
          case 'I': adjustGain(pid_i_gain_pitch, c, PID_TUNE_STEP, 0.0f, PID_I_GAIN_MAX); break;
          case 'u': adjustGain(pid_i_gain_yaw, c, PID_TUNE_STEP, 0.0f, PID_I_GAIN_MAX); break;

          case 'd': adjustGain(pid_d_gain_roll, c, PID_TUNE_STEP, 0.0f, PID_D_GAIN_MAX); break;
          case 'D': adjustGain(pid_d_gain_pitch, c, PID_TUNE_STEP, 0.0f, PID_D_GAIN_MAX); break;
          case 'Y': adjustGain(pid_d_gain_yaw, c, PID_TUNE_STEP, 0.0f, PID_D_GAIN_MAX); break;
        }

        printGains();
      }

      pending = 0;
    }
  }
}

// ================================================================
// SETUP / MAIN LOOP
// ================================================================

void setup() {
  pinMode(STATUS_LED_PIN, OUTPUT);
  digitalWrite(STATUS_LED_PIN, LOW);
  pinMode(BATTERY_SENSE_PIN, INPUT);

  configureEscPins();
  forceMotorsOff();

  Serial.begin(SERIAL_BAUD);
  delay(300);

  Serial.print(F("YMFC Flight Controller V6.6C_QMC5883P_COMPASS "));
  Serial.print(FIRMWARE_VERSION);
  Serial.print(F(" "));
  Serial.print(FIRMWARE_REVISION);
  Serial.println(F(" starting..."));

  Wire.begin();
  TWBR = 12; // 400 kHz I2C on 16 MHz Arduino Uno.
  Wire.setClock(I2C_SPEED);

  loadCalibrationFromEEPROM();

  configureReceiverInterrupts();

  if (!setupMPU6050()) {
    sensor_ok = false;
    Serial.println(F("ERROR: MPU6050 not responding at 0x68."));
  } else {
    sensor_ok = true;
    calibrateGyroAtBootIfNeeded();
  }

  // Compass is optional / non-fatal by request.
  // If it fails, the UAV continues with normal roll/pitch stabilization and yaw-rate behavior.
  if (!setupCompass()) {
    Serial.println(F("WARNING: Compass init failed at 0x2C. Continuing without heading hold."));
  } else {
    Serial.println(F("Compass OK at 0x2C. Heading hold available when yaw stick is centered."));
  }

  // Barometer is optional / telemetry-only. It does not block arming or control.
  if (!setupBarometer()) {
    Serial.println(F("WARNING: BMP280/BME280 init failed at 0x76. Continuing without barometer telemetry."));
  } else {
    Serial.println(F("Barometer OK at 0x76. Pressure and relative altitude telemetry active."));
    updateBarometer();
  }

  forceMotorsOff();
  writeEscPulses();
  updateBatteryMonitor();

  telemetryTimer = millis();
  ledTimer = millis();
  lastImuMicros = micros();

  Serial.println(F("Startup complete. Waiting for valid receiver, CH6 safe, throttle low."));
}

void loop() {
  loop_timer = micros();

  copyAndCalibrateReceiver();
  updateFlightModeCap();
  updateBatteryMonitor();

  if (sensor_ok && gyro_calibrated) {
    updateAngles();
  }

  updateCompass();
  updateBarometer();

  check_safety_and_arming();

  if (flight_mode == FLIGHT_ARMED) {
    calculate_pid();
    mixMotors();
  } else {
    forceMotorsOff();
    resetPID();
  }

  updateStatusLED(getLedState());

  writeEscPulses();

  handleSerialTuning();
  handleTelemetry();

  uint32_t elapsed = micros() - loop_timer;

  if (elapsed > LOOP_TIME_US) {
    // This reports on the next telemetry/LED cycle.
    loopOverrun = true;
  } else {
    loopOverrun = false;

    while ((uint32_t)(micros() - loop_timer) < LOOP_TIME_US) {
      // 250 Hz sync.
    }
  }
}
